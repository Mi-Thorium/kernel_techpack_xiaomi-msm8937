## touchscreen/ft5336/Kconfig
```kconfig
config TOUCHSCREEN_FT5336_MI8937
	tristate "FOCALTECH FT5336 touchpanel driver"
	depends on INPUT_TOUCHSCREEN
	default y
```

## touchscreen/ulysse/Kconfig
```kconfig
menu "Touchscreen (ulysse)"

source "techpack/xiaomi-msm8937/touchscreen/ulysse/gt9xx/Kconfig"
source "techpack/xiaomi-msm8937/touchscreen/ulysse/ft5435/Kconfig"

endmenu
```
